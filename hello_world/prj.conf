## CMakeLists.txt
```
# SPDX-License-Identifier: Apache-2.0

cmake_minimum_required(VERSION 3.28.0)

find_package(Zephyr REQUIRED HINTS $ENV{ZEPHYR_BASE})
project(hello_world)

target_sources(app PRIVATE 
    src/main.c
)
# LED模块
if(CONFIG_MODULE_LED)
    target_sources(app PRIVATE src/shell_led_cmd.c)
endif()
# cdc acm模块
if(CONFIG_MODULE_CDC_ACM)
    target_sources(app PRIVATE src/shell_uart_cmd.c)
endif()
# PWM LED模块
if(CONFIG_MODULE_PWM)
    target_sources(app PRIVATE src/shell_pwm_led_cmd.c)
endif()
# LITTLEFS模块
if(CONFIG_MODULE_SPI_FLASH)
    target_sources(app PRIVATE src/shell_littlefs_cmd.c)
endif()


target_include_directories(app PRIVATE
    include
)
```

## Kconfig
```
# 应用根目录的 Kconfig
mainmenu "My Application Configuration"

rsource "modules/led/Kconfig"
rsource "modules/cdc_acm/Kconfig"
rsource "modules/pwm/Kconfig"
rsource "modules/spi_flash/Kconfig"
rsource "modules/eeprom/Kconfig"
rsource "modules/adc/Kconfig"
rsource "modules/dac/Kconfig"

source "Kconfig.zephyr"
```

## sysbuild.conf
```
SB_CONFIG_BOOTLOADER_MCUBOOT=y
SB_CONFIG_BOOT_SIGNATURE_TYPE_ECDSA_P256=y
SB_CONFIG_BOOT_SIGNATURE_KEY_FILE="/home/ubuntu/work/stm32f407_zephyr/hello_world/signing-key.pem"  # 改用相对 workspace 根目录的路径

#SB_CONFIG_MCUBOOT_MODE_SWAP_SCRATCH=y
SB_CONFIG_MCUBOOT_MODE_SWAP_USING_MOVE=y
#SB_CONFIG_MCUBOOT_MODE_SWAP_USING_OFFSET=y
```

## prj.conf
```kconfig
 
CONFIG_GPIO=y
CONFIG_SERIAL=y
CONFIG_UART_INTERRUPT_DRIVEN=y
CONFIG_CACHE_MANAGEMENT=y
CONFIG_CLOCK_CONTROL=y
CONFIG_CONSOLE=y
CONFIG_UART_CONSOLE=y

CONFIG_LOG=y
#CONFIG_LOG_DEFAULT_LEVEL=2
#CONFIG_LOG_RUNTIME_FILTERING=y  #运行时动态过滤
#CONFIG_LOG_BUFFER_SIZE=2048
CONFIG_LOG_PRINTK=y

CONFIG_COVERAGE=n
CONFIG_LOG_TAG_MAX_LEN=8
CONFIG_LOG_CMDS=y
CONFIG_LOG_BACKEND_UART=y
#CONFIG_LOG_MODE_IMMEDIATE=y

# 启用 Shell
CONFIG_SHELL=y

# 启用串口后端
CONFIG_SHELL_BACKEND_SERIAL=y

# 配置 Shell 缓冲区大小
CONFIG_SHELL_CMD_BUFF_SIZE=256

# 启用命令历史
CONFIG_SHELL_HISTORY=y
CONFIG_SHELL_HISTORY_BUFFER=512

# 启用 Tab 自动补全
CONFIG_SHELL_TAB=y
CONFIG_SHELL_TAB_AUTOCOMPLETION=y

# 启用 VT100 颜色
CONFIG_SHELL_VT100_COLORS=y


CONFIG_PRINTK=y


# Flash 驱动基础
CONFIG_FLASH=y
# Flash Map 抽象模块（提供 flash_area API）
CONFIG_FLASH_MAP=y
# Flash 页布局支持
CONFIG_FLASH_PAGE_LAYOUT=y


#littleFS
CONFIG_FILE_SYSTEM=y
CONFIG_FILE_SYSTEM_LITTLEFS=y
CONFIG_FILE_SYSTEM_SHELL=y

# 配置 LittleFS 参数
CONFIG_FS_LITTLEFS_NUM_FILES=4
CONFIG_FS_LITTLEFS_NUM_DIRS=4
CONFIG_FS_LITTLEFS_CACHE_SIZE=256

CONFIG_MAIN_STACK_SIZE=3072


# 启用日志的 LittleFS 后端
#CONFIG_LOG_BACKEND_FS=y
# 挂载点，需 littlefs 挂载点一致
#CONFIG_LOG_BACKEND_FS_DIR="/lfs"
# 单个日志文件的最大大小（字节）
#CONFIG_LOG_BACKEND_FS_FILE_SIZE=4096
# 保留的最大日志文件数量（超出后会覆盖最旧的）
#CONFIG_LOG_BACKEND_FS_FILES_LIMIT=3

# 推荐：为日志处理线程增加栈空间，避免溢出
#CONFIG_LOG_PROCESS_THREAD_STACK_SIZE=4096

#监控线程运行时间
#CONFIG_THREAD_MONITOR=y
#CONFIG_SCHED_THREAD_USAGE=y
#CONFIG_THREAD_RUNTIME_STATS=y

CONFIG_STREAM_FLASH=y
CONFIG_POSIX_API=y
```

## prj_bak.conf
```kconfig
 
CONFIG_GPIO=y
CONFIG_SERIAL=y
CONFIG_UART_INTERRUPT_DRIVEN=y
CONFIG_CACHE_MANAGEMENT=y
CONFIG_CLOCK_CONTROL=y
CONFIG_CONSOLE=y
#CONFIG_ARMV8_A_NS=y
#CONFIG_ARM64_VA_BITS_36=y
#CONFIG_ARM64_PA_BITS_36=y
CONFIG_UART_CONSOLE=y

CONFIG_LOG=y
#CONFIG_LOG_DEFAULT_LEVEL=2
CONFIG_LOG_MODE_DEFERRED=y
#CONFIG_LOG_RUNTIME_FILTERING=y  #运行时动态过滤
CONFIG_LOG_BUFFER_SIZE=2048
CONFIG_LOG_PRINTK=y
CONFIG_LOG_PROCESS_TRIGGER_THRESHOLD=0
CONFIG_COVERAGE=n
CONFIG_LOG_TAG_MAX_LEN=8
CONFIG_LOG_CMDS=y
CONFIG_LOG_BACKEND_UART=y
CONFIG_LOG_MODE_IMMEDIATE=y

# 启用 Shell
CONFIG_SHELL=y

# 启用串口后端
CONFIG_SHELL_BACKEND_SERIAL=y

# 配置 Shell 缓冲区大小
CONFIG_SHELL_CMD_BUFF_SIZE=256

# 启用命令历史
CONFIG_SHELL_HISTORY=y
CONFIG_SHELL_HISTORY_BUFFER=512

# 启用 Tab 自动补全
CONFIG_SHELL_TAB=y
CONFIG_SHELL_TAB_AUTOCOMPLETION=y

# 启用 VT100 颜色
CONFIG_SHELL_VT100_COLORS=y


CONFIG_PRINTK=y


# Flash 驱动基础
CONFIG_FLASH=y
# Flash Map 抽象模块（提供 flash_area API）
CONFIG_FLASH_MAP=y
# Flash 页布局支持
CONFIG_FLASH_PAGE_LAYOUT=y


#littleFS
CONFIG_FILE_SYSTEM=y
CONFIG_FILE_SYSTEM_LITTLEFS=y
CONFIG_FILE_SYSTEM_SHELL=y

# 配置 LittleFS 参数
CONFIG_FS_LITTLEFS_NUM_FILES=4
CONFIG_FS_LITTLEFS_NUM_DIRS=4
CONFIG_FS_LITTLEFS_CACHE_SIZE=256

CONFIG_MAIN_STACK_SIZE=3072


# 启用日志的 LittleFS 后端
#CONFIG_LOG_BACKEND_FS=y
# 挂载点，需 littlefs 挂载点一致
#CONFIG_LOG_BACKEND_FS_DIR="/lfs"
# 单个日志文件的最大大小（字节）
#CONFIG_LOG_BACKEND_FS_FILE_SIZE=4096
# 保留的最大日志文件数量（超出后会覆盖最旧的）
#CONFIG_LOG_BACKEND_FS_FILES_LIMIT=3

# 推荐：为日志处理线程增加栈空间，避免溢出
CONFIG_LOG_PROCESS_THREAD_STACK_SIZE=4096

#监控线程运行时间
#CONFIG_THREAD_MONITOR=y
#CONFIG_SCHED_THREAD_USAGE=y
#CONFIG_THREAD_RUNTIME_STATS=y


CONFIG_STREAM_FLASH=y
CONFIG_POSIX_API=y
```

## src/main.c
```c
#include <zephyr/kernel.h>
#include <zephyr/logging/log.h>
#include <zephyr/drivers/uart.h>
#include <zephyr/shell/shell.h>
#include <zephyr/sys/printk.h>
#include <zephyr/drivers/gpio.h>
#include <zephyr/drivers/flash.h>
#include "main.h"

LOG_MODULE_REGISTER(main,LOG_LEVEL_DBG);

#define SLEEP_TIME_MS   2000

#ifdef CONFIG_MODULE_LED
#define LED0_NODE DT_ALIAS(led1)
static const struct gpio_dt_spec led = GPIO_DT_SPEC_GET(LED0_NODE, gpios);
#endif

#define SPI_FLASH_COMPAT jedec_spi_nor


int main(void)
{

    k_msleep(SLEEP_TIME_MS);
    printk("Application started\n");
  
    printk("UART interrupt mode enabled\n");


    //littlefs_example();
    //flash_test();
    //k_msleep(SLEEP_TIME_MS);
    //print_thread_stats();
#ifdef CONFIG_MODULE_LED
    if(!gpio_is_ready_dt(&led)){
        printk("gpio is not ready\n");
        return -1;
    }
    int ret = gpio_pin_configure_dt(&led,GPIO_OUTPUT_ACTIVE);
    if(ret < 0){
        printk("Failed to configure LED\n");
        return ret;
    }
#endif


#if 0
 
    char data[32] = {0};

    const struct device *flash_dev = DEVICE_DT_GET_ONE(SPI_FLASH_COMPAT);
    if(!device_is_ready(flash_dev)){
        printk("SPI flash device is not ready\n");
        return -1;
    }
    printk("SPI flash device is ready\n");
    int rc = flash_erase(flash_dev,0x0,0x1000);
    if(rc < 0){
        printk("Failed to erase flash\n");
        return rc;
    }
    rc = flash_write(flash_dev,0x0,&"hello world",12);
    if(rc < 0){
        printk("Failed to write flash\n");
        return rc;
    }
    printk("Flash write success\n");
    rc = flash_read(flash_dev,0x0,data,12);
    if(rc < 0){
        printk("Failed to read flash\n");
        return rc;
    }
    printk("Read data: %s\n",data);

#endif

    while(1){
        //闪烁LED
#ifdef CONFIG_MODULE_LED
        gpio_pin_toggle_dt(&led);
#endif
        k_msleep(SLEEP_TIME_MS);
    }
    return 0;

}
```

## include/main.h
```c
#ifndef __MAIN_H
#define __MAIN_H

void flash_test(void);
void littlefs_example(void);
#endif
```

## src/littlefs.c
```c
#include <zephyr/fs/fs.h>
#include <zephyr/fs/littlefs.h>
#include <zephyr/storage/flash_map.h>
#include <zephyr/logging/log.h>
#include "main.h"
LOG_MODULE_REGISTER(littlefs_example, LOG_LEVEL_INF);

// 定义挂载点
FS_LITTLEFS_DECLARE_DEFAULT_CONFIG(storage);
static struct fs_mount_t lfs_mnt = {
    .type = FS_LITTLEFS,
    .fs_data = &storage,
    .storage_dev = (void *)FIXED_PARTITION_ID(slot1_partition),
    .mnt_point = "/lfs",
};

void littlefs_example(void)
{
    struct fs_file_t file;
    int rc;

    // 挂载文件系统
    rc = fs_mount(&lfs_mnt);
    if (rc != 0) {
        LOG_ERR("Failed to mount filesystem: %d", rc);
        return;
    }
    LOG_INF("Filesystem mounted at %s", lfs_mnt.mnt_point);

    // 初始化文件结构
    fs_file_t_init(&file);

    // 打开文件（创建或覆盖）
    rc = fs_open(&file, "/lfs/test.txt", FS_O_CREATE | FS_O_WRITE);
    if (rc != 0) {
        LOG_ERR("Failed to open file: %d", rc);
        return;
    }

    // 写入数据
    const char *data = "Hello, LittleFS!";
    rc = fs_write(&file, data, strlen(data));
    if (rc < 0) {
        LOG_ERR("Failed to write file: %d", rc);
        fs_close(&file);
        return;
    }
    LOG_INF("Wrote %d bytes", rc);

    // 关闭文件
    fs_close(&file);

    // 重新打开文件读取
    rc = fs_open(&file, "/lfs/test.txt", FS_O_READ);
    if (rc != 0) {
        LOG_ERR("Failed to open file for reading: %d", rc);
        return;
    }

    // 读取数据
    char read_buf[64];
    rc = fs_read(&file, read_buf, sizeof(read_buf) - 1);
    if (rc < 0) {
        LOG_ERR("Failed to read file: %d", rc);
        fs_close(&file);
        return;
    }
    read_buf[rc] = '\0';
    LOG_INF("Read: %s", read_buf);

    // 关闭文件
    fs_close(&file);

    // 列出目录内容
    struct fs_dir_t dir;
    fs_dir_t_init(&dir);

    rc = fs_opendir(&dir, "/lfs");
    if (rc != 0) {
        LOG_ERR("Failed to open directory: %d", rc);
        return;
    }

    struct fs_dirent entry;
    while (fs_readdir(&dir, &entry) == 0) {
        if (entry.name[0] == 0) {
            break;
        }
        LOG_INF("File: %s, size: %zu", entry.name, entry.size);
    }

    fs_closedir(&dir);
}
   
```

## src/shell_led_cmd.c
```c
#include <zephyr/shell/shell.h>
#include <zephyr/logging/log.h>
#include <zephyr/kernel.h>
#include <stdlib.h>
#include <zephyr/drivers/gpio.h>

#define LED0_NODE DT_ALIAS(led0)

static const struct gpio_dt_spec led = GPIO_DT_SPEC_GET(LED0_NODE, gpios);

LOG_MODULE_REGISTER(led_shell,LOG_LEVEL_INF);

static int cmd_led_on(const struct shell *sh, size_t argc, char **argv)
{
    ARG_UNUSED(argc);
    ARG_UNUSED(argv);
    if(!gpio_is_ready_dt(&led)){
        shell_print(sh,"gpio is not ready!");
        return -1;
    }
    int ret = gpio_pin_configure_dt(&led,GPIO_OUTPUT_ACTIVE);
    if(ret < 0){
        shell_print(sh,"Failed to configure LED");
        return ret;
    }
    ret = gpio_pin_set_dt(&led, 1);
    if(ret < 0){
        shell_print(sh,"Failed to set gpio!");
    }
    shell_print(sh,"Turn led on!");
    return 0;
}

static int cmd_led_off(const struct shell *sh, size_t argc, char **argv)
{
    ARG_UNUSED(argc);
    ARG_UNUSED(argv);
    if(!gpio_is_ready_dt(&led)){
        shell_print(sh,"gpio is not ready!");
        return -1;
    }
    int ret = gpio_pin_configure_dt(&led,GPIO_OUTPUT_ACTIVE);
    if(ret < 0){
        shell_print(sh,"Failed to configure LED");
        return ret;
    }
    ret = gpio_pin_set_dt(&led, 0);
    if(ret < 0){
        shell_print(sh,"Failed to set gpio!");
    }
    shell_print(sh,"Turn led off!");

    return 0;
}

static int cmd_led_set(const struct shell *sh, size_t argc, char **argv)
{
    if (argc != 2) {
        shell_error(sh, "Usage: led set <0/1>");
        return -EINVAL;
    }
    if(!gpio_is_ready_dt(&led)){
        shell_print(sh,"gpio is not ready!");
        return -1;
    }
    int ret = gpio_pin_configure_dt(&led,GPIO_OUTPUT_ACTIVE);
    if(ret < 0){
        shell_print(sh,"Failed to configure LED");
        return ret;
    }
    int level = atoi(argv[1]);
    ret = gpio_pin_set_dt(&led, level);
    if(ret < 0){
        shell_print(sh,"Failed to set gpio!");
    }
    shell_print(sh,"Set led!");

    return 0;
}

SHELL_STATIC_SUBCMD_SET_CREATE(sub_led,
        SHELL_CMD(on,NULL,"turn led on",cmd_led_on),
        SHELL_CMD(off,NULL,"turn led off",cmd_led_off),
        SHELL_CMD(set,NULL,"turn led on/off",cmd_led_set),
        SHELL_SUBCMD_SET_END
);

SHELL_CMD_REGISTER(led,&sub_led,"led controller",NULL);
```

## src/shell_uart_cmd.c
```c
#include <zephyr/shell/shell.h>
#include <zephyr/kernel.h>
#include <zephyr/drivers/uart.h>

/* 假设应用程序已经全局初始化了 uart 指针 */
extern const struct device *uart;

static int cmd_uart_send(const struct shell *sh, size_t argc, char **argv)
{
    if (argc < 2) {
        shell_print(sh, "Usage: uart send <string>");
        return -EINVAL;
    }

    /* 直接使用已有的 uart 设备发送 */
    for (int i = 0; argv[1][i] != '\0'; i++) {
        uart_poll_out(uart, argv[1][i]);
    }
    uart_poll_out(uart, '\r');
    uart_poll_out(uart, '\n');

    shell_print(sh, "Sent: %s", argv[1]);
    return 0;
}

SHELL_CMD_REGISTER(uart_send, NULL, "Send data over UART", cmd_uart_send);
```
