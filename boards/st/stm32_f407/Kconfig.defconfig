## boards/st/stm32_f407/board.yml
```yaml
board:
  name: stm32f407
  full_name: STM32F407 Discovery
  vendor: st
  socs:
    - name: stm32f407xx
```

## hello_world/build/hello_world/Kconfig/boards/Kconfig.defconfig
```kconfig
# Load Zephyr board defconfig descriptions.
osource "/home/ubuntu/work/stm32f407_zephyr/boards/st/stm32_f407/Kconfig.defconfig"
```

## hello_world/build/mcuboot/Kconfig/boards/Kconfig.sysbuild
```kconfig
# Load Sysbuild board Kconfig descriptions.
osource "/home/ubuntu/work/stm32f407_zephyr/boards/st/stm32_f407/Kconfig.sysbuild"
```
